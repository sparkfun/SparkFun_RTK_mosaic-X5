## Firmware/RTK_mosaic-X5_Firmware/main/Kconfig.projbuild
```kconfig
menu "Example Configuration"

    choice EXAMPLE_ESP_WIFI_STA_AUTHMODE_THRESHOLD
        prompt "WiFi STA scan authentication threshold"
        default EXAMPLE_ESP_WIFI_STA_AUTHMODE_THRESHOLD_WPA2_PSK
        help
            Minimum authentication mode accepted when scanning and connecting as a station.
            Lower this to connect to older networks (WEP/WPA).

        config EXAMPLE_ESP_WIFI_STA_AUTHMODE_THRESHOLD_OPEN
            bool "Open"
        config EXAMPLE_ESP_WIFI_STA_AUTHMODE_THRESHOLD_WEP
            bool "WEP"
        config EXAMPLE_ESP_WIFI_STA_AUTHMODE_THRESHOLD_WPA_PSK
            bool "WPA PSK"
        config EXAMPLE_ESP_WIFI_STA_AUTHMODE_THRESHOLD_WPA2_PSK
            bool "WPA2 PSK"
        config EXAMPLE_ESP_WIFI_STA_AUTHMODE_THRESHOLD_WPA_WPA2_PSK
            bool "WPA/WPA2 PSK"
        config EXAMPLE_ESP_WIFI_STA_AUTHMODE_THRESHOLD_WPA3_PSK
            bool "WPA3 PSK"
    endchoice

endmenu
```

## Firmware/RTK_mosaic-X5_Firmware/sdkconfig.defaults
```kconfig
#
# 4MB Flash
#
CONFIG_ESPTOOLPY_FLASHSIZE_4MB=y
#
# WiFi Station Configuration
#
CONFIG_EXAMPLE_ESP_WIFI_STA_AUTHMODE_THRESHOLD_WPA2_PSK=y
#
# Ethernet
#
CONFIG_ETHERNET_INTERNAL_SUPPORT=y
CONFIG_ETH_ENABLED=y
CONFIG_ETH_USE_ESP32_EMAC=y
CONFIG_ETHERNET_PHY_INTERFACE_RMII=y
CONFIG_ETHERNET_PHY_KSZ80XX=y
CONFIG_ETH_TRANSMIT_MUTEX=y
CONFIG_ETHERNET_RMII_CLK_OUTPUT=y
CONFIG_ETHERNET_RMII_CLK_GPIO=0
CONFIG_ETHERNET_MDC_GPIO=23
CONFIG_ETHERNET_MDIO_GPIO=18
CONFIG_ETHERNET_PHY_RST_GPIO=5
CONFIG_ETHERNET_PHY_ADDR=1
CONFIG_ETHERNET_DMA_BURST_LEN_DEFAULT=y
CONFIG_ETHERNET_SOC_EMAC_SUPPORT_1000M=0
#
# Custom partitions - for nvs and fat
#
CONFIG_PARTITION_TABLE_CUSTOM=y
CONFIG_PARTITION_TABLE_CUSTOM_FILENAME="partitions.csv"
CONFIG_PARTITION_TABLE_FILENAME="partitions.csv"
```
