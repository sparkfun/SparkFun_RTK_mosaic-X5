## Firmware/RTK_mosaic-X5_basic/main/Kconfig.projbuild
```kconfig
menu "RTK mosaic-X5 WiFi Basic Configuration"

    config RTK_X5_WIFI_SSID 
        string "SSID of targeted Access Point"
        default "wifi_SSID"

    config RTK_X5_WIFI_PSWD 
        string "Password of targeted Access Point"
        default "wifi_password"

    config RTK_X5_FLOW_CONTROL_QUEUE_TIMEOUT_MS 
        int "Flow Control Queue Timeout [ms]"
        default 100

    config RTK_X5_FLOW_CONTROL_QUEUE_LENGTH
        int "Flow Control Queue Length"
        default 40

    config RTK_X5_FLOW_CONTROL_WIFI_SEND_TIMEOUT_MS
        int "Flow Control WiFi Send Timeout [ms]"
        default 100

    config RTK_X5_MOSAIC_UART_PORT_NUM
        int "ESP x Mosaic UART Port Number of ESP"
        default 1

    config RTK_X5_MOSAIC_UART_BUF_SIZE
        int "ESP x Mosaic UART Buffer Size"
        default 1024

    config RTK_X5_WIFI_GPIO_PIN
        int "The ESP32 GPIO pin for the WiFi LED"
        default 12

    config RTK_X5_UART_TX_GPIO_PIN
        int "The ESP32 GPIO pin for Serial TX - connected to the X5 COM4 RX"
        default 2

    config RTK_X5_UART_RX_GPIO_PIN
        int "The ESP32 GPIO pin for Serial RX - connected to the X5 COM4 TX"
        default 4

    config RTK_X5_ETHERNET_PHY_ADDR
        int "The Ethernet PHY address"
        default 1

    config RTK_X5_ETHERNET_ERST_GPIO
        int "The ESP32 GPIO pin for Ethernet RST"
        default 5

    config RTK_X5_ETHERNET_MDC_GPIO
        int "The ESP32 GPIO pin for Ethernet MDC"
        default 23

    config RTK_X5_ETHERNET_MDIO_GPIO
        int "The ESP32 GPIO pin for Ethernet MDIO"
        default 18

    config RTK_X5_VERBOSE_LOG
        bool "Enable extra WiFi and Ethernet log messages"
        default n

endmenu
```

## Test_Sketches/RTK_mosaic-X5_WiFi_STN_BT_Prov/main/Kconfig.projbuild
```kconfig
menu "RTK mosaic-X5 WiFi STN config"

    config RTK_X5_FLOW_CONTROL_QUEUE_TIMEOUT_MS 
        int "Flow Control Queue Timeout [ms]"
        default 100

    config RTK_X5_FLOW_CONTROL_QUEUE_LENGTH
        int "Flow Control Queue Length"
        default 40

    config RTK_X5_FLOW_CONTROL_WIFI_SEND_TIMEOUT_MS
        int "Flow Control WiFi Send Timeout [ms]"
        default 100

    config  MOWI_PROV_MGR_REMEMBER
        bool "Remember previous state and skip provisioning"
        default y

    config RTK_X5_VERBOSE_LOG
        bool "Enable extra WiFi and Ethernet log messages"
        default n

endmenu
```
